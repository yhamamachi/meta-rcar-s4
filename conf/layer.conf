## conf/machine/s4sk.conf
```bitbake
#@TYPE: Machine
#@NAME: S4SK machine
#@DESCRIPTION: Machine configuration for running ironhide

SOC_FAMILY = "r8a779f4"
SOC_FAMILY =. "rcar-gen4:"

require conf/machine/rcars4.inc

# Device tree
KERNEL_DEVICETREE = "\
    renesas/r8a779f4-s4sk.dtb \
"
SERIAL_CONSOLES = "921600;ttySC0"
# u-boot configure
UBOOT_MACHINE = "r8a779f4_s4sk_defconfig"
```

## conf/machine/spider.conf
```bitbake
#@TYPE: Machine
#@NAME: Spider machine
#@DESCRIPTION: Machine configuration for running ironhide

require conf/machine/rcars4.inc

SOC_FAMILY = "r8a779f0"
SOC_FAMILY =. "rcar-gen4:"

# Device tree
KERNEL_DEVICETREE = "\
    renesas/r8a779f0-spider.dtb \
"
SERIAL_CONSOLES = "1843200;ttySC0"
# u-boot configure
UBOOT_MACHINE = "r8a779f0_spider_defconfig"
```
